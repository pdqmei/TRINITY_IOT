## sdkconfig.defaults
```kconfig
# ESP-IDF Configuration File - Device Configuration

# Chip target
CONFIG_IDF_TARGET="esp32"

# Partition Scheme
CONFIG_PARTITION_TABLE_SINGLE_APP=y

# Serial Port Settings
CONFIG_ESPTOOLPY_PORT="/dev/ttyUSB0"
CONFIG_ESPTOOLPY_BAUD=115200
CONFIG_ESPTOOLPY_CHIP_RST_PIN=0

# WiFi Configuration
CONFIG_ESP_WIFI_SOFTAP_SUPPORT=n
CONFIG_ESP_WIFI_TX_POWER_CALIBRATION=y
CONFIG_ESP_WIFI_NVS_ENABLED=y

# MQTT Configuration
CONFIG_MQTT_PROTOCOL_311=y
CONFIG_MQTT_TRANSPORT_SSL=y
CONFIG_MQTT_TRANSPORT_WEBSOCKET=y

# Logging Configuration
CONFIG_LOG_DEFAULT_LEVEL=3
CONFIG_LOG_LEVEL_MAIN=3

# FreeRTOS Configuration
CONFIG_FREERTOS_HZ=100
CONFIG_FREERTOS_WATCHPOINT_END_OF_STACK=y

# NVS Flash Configuration
CONFIG_NVS_FLASH_FREQ=40m
CONFIG_NVS_FLASH_MODE=dio

# I2C Configuration
CONFIG_I2C_ENABLE_DEBUG_LOG=n

# ADC Configuration
CONFIG_ADC_DISABLE_DAC=n

# Task Watchdog Configuration
CONFIG_TASK_WDT=y
CONFIG_TASK_WDT_TIMEOUT_S=15
CONFIG_TASK_WDT_CHECK_IDLE_TASK_CPU0=y
CONFIG_TASK_WDT_CHECK_IDLE_TASK_CPU1=y

# User configurable WiFi credentials (set via menuconfig)
CONFIG_ESP_WIFI_SSID="THANH NGUYEN 2.4G"
CONFIG_ESP_WIFI_PASSWORD="0904653455"

# Default MQTT broker
CONFIG_MQTT_BROKER_URI="mqtt://broker.hivemq.com"
# Force GCC compiler (Clang fails on Windows)
CONFIG_COMPILER_SELECTION_GCC=y
CONFIG_COMPILER_SELECTION_CLANG=n
```
